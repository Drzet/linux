## Documentation/devicetree/bindings/media/qcom,sm8475-iris-dma.yaml
```yaml
# SPDX-License-Identifier: (GPL-2.0-only OR BSD-2-Clause)
%YAML 1.2
---
$id: http://devicetree.org/schemas/media/qcom,sm8475-iris-dma.yaml#
$schema: http://devicetree.org/meta-schemas/core.yaml#

title: Qualcomm SM8475 Iris nonsecure DMA consumers (experimental RFC)

maintainers:
  - Vikash Garodia <quic_vgarodia@quicinc.com>
  - Dikshita Agarwal <dikshita.agarwal@oss.qualcomm.com>

description: |
  Proposed ABI for two independently enumerated DMA consumers referenced in
  nonpixel,pixel order by the Iris controller's qcom,dma-consumers property.
  Each owns one nonsecure SMMU stream match entry and a separate DMA domain.
  These nodes are peers of the controller on the SoC bus; they have no MMIO
  registers or dependency on controller probe. Secure contexts are excluded.
  This software topology is experimental, not observed physical topology.

  memory-region references exactly two IOVA-only reservations, without reg,
  each containing a single iommu-addresses tuple targeting this consumer.
  With the SoC bus's two address and two size cells, the first excludes
  [0,0x25800000) for nonpixel or [0,0x00100000) for pixel. The second excludes
  [0xe0000000,0x100000000). This conserves reference software windows; their
  necessity on hardware is unproven. Both consumers use a contiguous 32-bit
  DMA mask. The controller's physical PAS firmware carveout stays separate.

properties:
  compatible:
    enum:
      - qcom,sm8475-iris-nonpixel
      - qcom,sm8475-iris-pixel

  iommus:
    maxItems: 1
    description: |
      One apps SMMU SID/mask pair, 0x2180/0x400 for nonpixel or
      0x2187/0x400 for pixel, from the stock reference DT.

  memory-region:
    items:
      - description: IOVA-only lower exclusion, targeting this consumer
      - description: IOVA-only upper exclusion, targeting this consumer

  dma-coherent: true

required:
  - compatible
  - iommus
  - memory-region
  - dma-coherent

additionalProperties: false
...
```

## Documentation/devicetree/bindings/media/qcom,sm8475-iris.yaml
```yaml
# SPDX-License-Identifier: (GPL-2.0-only OR BSD-2-Clause)
%YAML 1.2
---
$id: http://devicetree.org/schemas/media/qcom,sm8475-iris.yaml#
$schema: http://devicetree.org/meta-schemas/core.yaml#

title: Qualcomm SM8475 Iris2 video accelerator

maintainers:
  - Vikash Garodia <quic_vgarodia@quicinc.com>
  - Dikshita Agarwal <dikshita.agarwal@oss.qualcomm.com>

description: |
  [INFERRED] Upstream SM8475-specific compatible and resource translation
  for the VPU2 Iris controller documented by Qualcomm's Waipio/Cape video
  device tree as shipped in Motorola's source. Firmware and board operation
  are not verified. This is a candidate binding, not an enabled oneli node.

allOf:
  - $ref: qcom,venus-common.yaml#

properties:
  compatible:
    const: qcom,sm8475-iris

  clocks:
    maxItems: 3

  clock-names:
    items:
      - const: iface
      - const: core
      - const: vcodec0_core

  power-domains:
    minItems: 4
    maxItems: 4

  power-domain-names:
    items:
      - const: venus
      - const: vcodec0
      - const: mxc
      - const: mmcx

  firmware-name:
    maxItems: 1

  interconnects:
    description: |
      Configuration path from APPSS_PROC to VENUS_CFG, VIDEO to LLCC,
      and a disjoint LLCC to EBI path. Use ALWAYS tags on both endpoints.
      The VIDEO path must terminate at LLCC, not overlap the DDR path.
    minItems: 3
    maxItems: 3

  interconnect-names:
    items:
      - const: cpu-cfg
      - const: video-llcc
      - const: video-mem

  # With upstream Iris DMA child devices the parent must not own both streams.
  # Child stream values remain reference-FDT data, not verified live hardware.
  iommus: false

  # [INFERRED] Conservatively retain the stock pixel low-IOVA exclusion;
  # generic upstream VPU3+ pixel subnodes do not require an iommu-ranges.
  pixel:
    required:
      - iommu-ranges

  # This first offline candidate only models nonsecure stream ownership.
  secure-non-pixel: false
  secure-pixel: false
  secure-bitstream: false

  resets:
    minItems: 2
    maxItems: 2

  reset-names:
    items:
      - const: bus
      - const: core

  dma-coherent: true

  operating-points-v2:
    description: |
      Restricted development policy uses consumer frequencies 240, 338, 366
      and 444 MHz, with required-opps ordered MXC, MMCX. The required levels
      are respectively SVS/LOW_SVS, SVS/SVS, SVS_L1/SVS_L1 and NOM/NOM.
      Consumer division by three is an accepted development assumption,
      not a physical divider measurement. Provider rounding and readback
      must remain within the row's parent/supply envelope.

required:
  - compatible
  - firmware-name
  - interconnects
  - interconnect-names
  - power-domain-names
  - operating-points-v2
  - resets
  - reset-names
  - '#address-cells'
  - '#size-cells'
  - dma-ranges
  - non-pixel
  - pixel
  - dma-coherent

unevaluatedProperties: false
...
```

## Documentation/devicetree/bindings/phy/nxp,ptn3222.yaml
```yaml
# SPDX-License-Identifier: GPL-2.0-only OR BSD-2-Clause
%YAML 1.2
---
$id: http://devicetree.org/schemas/phy/nxp,ptn3222.yaml#
$schema: http://devicetree.org/meta-schemas/core.yaml#

title: NXP PTN3222 1-port eUSB2 to USB2 redriver

maintainers:
  - Dmitry Baryshkov <dmitry.baryshkov@linaro.org>

properties:
  compatible:
    enum:
      - nxp,ptn3222

  reg:
    maxItems: 1

  "#phy-cells":
    const: 0

  vdd1v8-supply:
    description: power supply (1.8V)

  vdd3v3-supply:
    description: power supply (3.3V)

  reset-gpios: true

  nxp,usb2-tuning-profile:
    $ref: /schemas/types.yaml#/definitions/string
    enum:
      - motorola,oneli
    description: |
      Board-specific USB2 signal conditioning profile from Motorola oneli's
      stock device tree. Programs USB2 RX control to 0x40, TX control 1 to
      0x22 and TX control 2 to 0x64 in device/OTG mode or 0x24 in host mode.
      Requests 1.8 V before 3.075-3.3 V and releases reset after both supplies
      are enabled. Requires readable PTN3222 CUK/GM or HUK chip identification
      registers; an unidentified part is rejected before any tuning writes.
      This profile does not identify the board's populated repeater; the
      compatible and physical reset polarity must be established separately.

required:
  - compatible
  - reg
  - '#phy-cells'

additionalProperties: false

allOf:
  - if:
      required:
        - nxp,usb2-tuning-profile
    then:
      required:
        - reset-gpios
        - vdd1v8-supply
        - vdd3v3-supply

examples:
  - |
    #include <dt-bindings/gpio/gpio.h>

    i2c {
        #address-cells = <1>;
        #size-cells = <0>;

        redriver@4f {
            compatible = "nxp,ptn3222";
            reg = <0x4f>;
            #phy-cells = <0>;
            vdd3v3-supply = <&vreg_3p3>;
            vdd1v8-supply = <&vreg_1p8>;
            reset-gpios = <&gpio_reset GPIO_ACTIVE_LOW>;
        };
    };
...
```
